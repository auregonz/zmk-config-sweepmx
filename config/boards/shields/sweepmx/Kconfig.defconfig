## config/boards/shields/sweepmx/Kconfig.defconfig
```kconfig
# Handle board configuration

if SHIELD_SWEEPMX_LEFT

config ZMK_KEYBOARD_NAME
	default "SweepMX"

config ZMK_SPLIT_ROLE_CENTRAL
	default y

endif

if SHIELD_SWEEPMX_LEFT || SHIELD_SWEEPMX_RIGHT

config ZMK_SPLIT
	default y

endif
```

## config/boards/shields/sweepmx/Kconfig.shield
```kconfig
# Define Keyboard

config SHIELD_SWEEPMX_LEFT
	def_bool $(shields_list_contains,sweepmx_left)

config SHIELD_SWEEPMX_RIGHT
	def_bool $(shields_list_contains,sweepmx_right)
```
